## config/west.yml
```yaml
manifest:
  remotes:
    - name: custom_zmkfirmware
      url-base: https://github.com/a-wark
    - name: tri-state
      url-base: https://github.com/dhruvinsh
    - name: a-wark
      url-base: https://github.com/a-wark
  projects:
    - name: zmk
      remote: custom_zmkfirmware
      revision: studio
      import: app/west.yml
    - name: zmk-tri-state
      remote: tri-state
      revision: main
    - name: nice-view-horizontal
      remote: a-wark
      revision: feat/horizontal
  self:
    path: config
```
